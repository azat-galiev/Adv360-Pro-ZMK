macro_switch_lang: macro_switch_lang {
    compatible = "zmk,behavior-macro";
    label = "macro_switch_lang";
    #binding-cells = <0>;
    wait-ms = <1>;
    bindings
        = <&macro_press &kp LEFT_ALT &kp LEFT_SHIFT>
        , <&macro_release &kp LEFT_SHIFT &kp LEFT_ALT>
        ;
};

macro_switch_to_ru: macro_switch_to_ru {
    compatible = "zmk,behavior-macro";
    label = "macro_switch_to_ru";
    #binding-cells = <0>;
    wait-ms = <1>;
    bindings
        = <&macro_press &kp LEFT_ALT &kp LEFT_SHIFT>
        , <&macro_tap &kp N1>
        , <&macro_release &kp LEFT_SHIFT &kp LEFT_ALT>
        ;
};

macro_switch_to_en: macro_switch_to_en {
    compatible = "zmk,behavior-macro";
    label = "macro_switch_to_en";
    #binding-cells = <0>;
    wait-ms = <1>;
    bindings
        = <&macro_press &kp LEFT_ALT &kp LEFT_SHIFT>
        , <&macro_tap &kp N0>
        , <&macro_release &kp LEFT_SHIFT &kp LEFT_ALT>
        ;
};

kp_or_switch_lang: kp_or_switch_lang {
    compatible = "zmk,behavior-hold-tap";
    label = "kp_or_switch_lang";
    #binding-cells = <2>;
    flavor = "hold-preferred";
    tapping-term-ms = <200>;
    bindings = <&kp>, <&macro_switch_lang>;
};
